//
// Единица межмодульной кодогенерации — «вклад» одного блока периферии в
// общий сгенерированный проект.
//
// Концепция (и причина существования этого файла). Раньше каждый
// однопериферийный генератор (codegen/gpio/, codegen/uart/, codegen/timer16/,
// codegen/i2c/ — удалены вместе с появлением этого слоя) выпускал ЦЕЛИКОМ три
// файла: mik32_init.h, mik32_init.c и main.c. Два таких генератора нельзя было
// запустить в один выходной каталог — второй затирал mik32_init.h/.c первого,
// потому что имена файлов совпадают, а содержимое разное (только GPIO_Init
// либо только UART_Init). Именно из-за этого существовал codegen/demo/ —
// руками сшитый третий генератор для одной конкретной пары GPIO+UART. При
// четырёх периферийных модулях таких «сшивок» потребовалось бы 11 (все
// непустые подмножества {gpio, uart, timer16, i2c}), и каждая новая периферия
// удваивала бы это число.
//
// Решение: периферийный модуль больше не выпускает файлы. Он выпускает
// PeripheralContribution — набор кусочков (includes, глобальные переменные,
// прототип, тело функции инициализации, необязательный кусок тела while(1)).
// Сшивкой занимается ровно один сборщик — codegen/project/project_codegen.cpp,
// который склеивает N вкладов в единственные mik32_init.h/.c/main.c. Число
// периферийных модулей растёт линейно, число сборщиков остаётся равным одному.
//
// Соответствие архитектуре: «МИК32 конфигуратор - Архитектура.md», §9.2
// (MVP: HAL-based кодогенерация) не меняется — каждый вклад по-прежнему
// содержит вызовы HAL, а не запись в регистры. Меняется только то, КТО
// собирает файл целиком.
//
#ifndef MIK32_CONFIGURATOR_PERIPHERAL_CONTRIBUTION_H
#define MIK32_CONFIGURATOR_PERIPHERAL_CONTRIBUTION_H

#include <string>
#include <vector>

struct PeripheralContribution
{
    // Человекочитаемое имя блока ("GPIO_0", "UART_1", "I2C_0", "TIMER16_2") —
    // идёт в диагностику ошибок и в комментарии сгенерированного кода.
    // Формируется как <ТИП>_<instance>, потому что при N блоках на тип
    // instance — единственное, что их различает (ТЗ §3.1.6.4 требует
    // называть блок в сообщении об ошибке).
    std::string label;

    // Заголовки HAL, нужные телу init-функции ("mik32_hal_gpio.h" и т.п.).
    // Список, а не готовая строка с #include: сборщик обязан устранить
    // дубликаты — два блока GPIO дадут mik32_hal_gpio.h дважды, а повторный
    // #include одного и того же HAL-заголовка хоть и безвреден (в SDK везде
    // стоят include guard'ы), но замусоривает выход и мешает сравнению с
    // golden-файлами в тестах.
    std::vector<std::string> init_c_includes;

    // Заголовки, нужные main.c — отдельно от init_c_includes, потому что
    // это разные множества: mik32_hal_gpio.h нужен main.c только если в теле
    // цикла реально есть HAL_GPIO_TogglePin, а xprintf.h нужен main.c и НЕ
    // нужен mik32_init.c.
    std::vector<std::string> main_c_includes;

    // Определения глобальных хендлов в mik32_init.c, например
    // "USART_HandleTypeDef husart_0;\n". Пусто для GPIO — HAL_GPIO_Init
    // работает без хендла, принимая указатель GPIO_0/1/2 напрямую.
    std::string global_definitions;

    // Те же хендлы как extern в main.c ("extern USART_HandleTypeDef husart_0;\n") —
    // нужны, только если тело цикла к ним обращается.
    std::string extern_declarations;

    // Прототипы, попадающие в mik32_init.h: и сама init-функция, и
    // вспомогательные (например I2C_0_Reset). Хранятся списком, чтобы
    // сборщик выводил их в стабильном порядке одним блоком.
    std::vector<std::string> public_prototypes;

    // Имя init-функции без скобок ("GPIO_0_Init") — сборщик сам построит из
    // него строку вызова в main(). Имя включает instance, потому что при N
    // блоках одного типа в одном проекте два "GPIO_Init" дали бы
    // переопределение символа и падение линковки.
    std::string init_function_name;

    // Полный текст init-функции вместе с предшествующим ей комментарием
    // (описание конфигурации, ссылки на errata) — сборщик вставляет его в
    // mik32_init.c как есть.
    std::string init_function_text;

    // Дополнительные функции в mik32_init.c помимо init (I2C_x_Reset, xputc).
    std::string helper_functions_text;

    // Необязательный кусок тела while(1) — demo-логика модуля (мигание
    // светодиодом, скан шины I2C, ping-pong). Решение пользователя: demo
    // остаётся полем модуля, а не отдельным флагом верхнего уровня, поэтому
    // сборщик просто конкатенирует непустые куски внутри одной секции
    // /* USER CODE BEGIN Loop */ (ТЗ §3.1.7.3).
    //
    // Контракт по отступу: строки записываются с базовым отступом в 12
    // пробелов. Сборщик оборачивает каждый непустой кусок в собственную
    // фигурную скобку с меткой модуля — без этого две demo-логики,
    // объявившие переменную с одинаковым именем (например ping_pong_done у
    // двух блоков I2C), столкнулись бы в одной области видимости и код не
    // скомпилировался бы. Скобки дают каждому вкладу свою область видимости
    // по построению, а не по договорённости об именах.
    std::string loop_body;

    // Модуль просит сборщик поставить общую задержку в конце тела цикла.
    // Задержка одна на весь цикл, а не по одной на модуль: при мигании
    // светодиода и печати лога одновременно две отдельные задержки развели бы
    // события по времени, и наблюдать их синхронно (светодиод + строка в
    // терминале) стало бы невозможно.
    bool wants_loop_delay = false;

    // Порядок вызова в main(): сборщик сортирует вклады по возрастанию.
    // Не алфавитный и не порядок блоков в JSON — порядок инициализации
    // периферии имеет физический смысл (см. kInitOrder* в
    // codegen/project/contribution_utils.h).
    int init_order = 0;
};

#endif //MIK32_CONFIGURATOR_PERIPHERAL_CONTRIBUTION_H
